/* Keyball39 – tame the scroll wheel
 *
 * This overlay configures layer-specific trackball behavior:
 * - Default: Standard mouse pointer movement (potentially scaled).
 * - SCROLL layer (SCROLL): Trackball movement becomes scroll, significantly slowed down.
 */

#include <input/processors.dtsi>   /* processors come from core ZMK */

// Define layer numbers to match keyball39.keymap
#define DEFAULT 0
#define MOUSE   6
#define SCROLL  7

/ {
    /* Optional: tone the sensor down a bit globally */
    &pmw3610 {                     /* label matches tangbonze repo */
        cpi = <300>;              /* default ≈ 600 – 300 feels sane for pointer */
    };

    /* Override trackball button behaviors - left/right stay, middle exits */
    &zip_button_behaviors {
        bindings = <&lclk_with_timeout &mclk_and_exit_base &rclk_stay>;
    };
};  